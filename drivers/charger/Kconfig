## drivers/charger/bq25120a/Kconfig
```kconfig
config BQ25120A
	bool "BQ25120A charger driver"
	default y
	depends on DT_HAS_TI_BQ25120A_ENABLED
	select I2C
	help
	  Enable BQ25120A charger driver.

config BQ25120A_ENABLE_LDO_ON_STARTUP
	bool "Enable LDO output on driver initialization"
	default n
	depends on BQ25120A
	help
	  Enable LDO output on driver startup

config BQ25120A_LDO_STARTUP_VALUE
	int "Voltage of the LDO on startup"
	depends on BQ25120A_ENABLE_LDO_ON_STARTUP
	range 8 39
	help
	  LDO voltage value in 100mV.
```

## drivers/led/is31fl3194/Kconfig
```kconfig
config IS31FL3194
	bool "IS31FL3194 LED driver"
	default y
	depends on DT_HAS_ISSI_IS31FL3194_ENABLED
	select I2C
	help
	  Enable IS31FL3194 LED driver.
```

## dts/bindings/charger/ti,bq25120a.yaml
```yaml
# Copyright 2024 Google LLC
# SPDX-License-Identifier: Apache-2.0

description: |
  bq25120A Low IQ Highly Integrated Battery Charge Management Solution for Wearables
  and IoT

  The device has a single child node for the charger. For example:

  bq25120a@6a {
    compatible = "ti,bq25120a";
    reg = <0x6a>;
  };

compatible: "ti,bq25120a"

include: [battery.yaml, i2c-device.yaml]
```

## dts/bindings/led/issi,is31fl3194.yaml
```yaml
# Copyright (c) 2023 Endor AG
# SPDX-License-Identifier: Apache-2.0

description: |
  is31fl3194 LED driver for Lumissil Microsystems (a division of ISSI)

compatible: "issi,is31fl3194"

include: ["i2c-device.yaml", "led-controller.yaml"]

properties:
  brightness:
    type: int
    description: Default brightness of the LED.
    enum:
       - 1
       - 2
       - 3
       - 4
       - 5
       - 6
       - 7
       - 8
    default: 4

child-binding:
  properties:
    label:
      required: true

    index:
      required: true

    color-mapping:
      required: true
```

## lib/BHI260AP/Kconfig
```kconfig
config BHI260AP
	bool "BHY2 Sensor API from Bosch Sensortec"
	help
	  This option enables Bosch Sensortec's BHy2 API.
```
